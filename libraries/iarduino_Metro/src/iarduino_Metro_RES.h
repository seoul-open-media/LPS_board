																										//
#ifndef iarduino_Metro_RES_h																			//	Функции работы с потенциометром.
#define iarduino_Metro_RES_h																			//
																										//
class iarduino_Metro_RES: public iarduino_Metro_BASE{													//	Определяем производный класс iarduino_Metro_RES.
	public:																								//
	/**	функции данного производного класса iarduino_Metro_RES		**/									//
	/**	дублирую функции полиморфного класса iarduino_Metro_BASE	**/									//
																										//
//		Функции не используемые в данном модуле:														//
		bool	begin			(int i0=NOT2, int i1=NOT2	){return 0;}								//	Инициализация модуля.
		int		test			(int i0=NOT2, int i1=NOT2	){return 0;}								//	Самотестирование модуля.
																										//
//		Выполняем действия:																				//
		bool	action			(int i0=NOT2, int i1=NOT2	){											//	Объявляем функцию выполнения действий.
								uint8_t data[2] = {0,0};												//	Определяем массив для хранения данных пакетно считываемых/записываемых в модуль.
								bool    result  = false;												//	Определяем флаг результата возвращаемый функцией action.
								uint8_t sumtry  = 10;													//	Количество попыток чтения/записи.
								switch(i0){																//
								//	Действие № 0 - установить значение ADC_CHANGE:						//
									case 0:																//
										do{	result	 =	iMetroI2C.writeByte( i1,REG_DATA+2,res_change);	//	Записываем значение res_change в регистр REG_DATA+2 модуля с адресом i1.
											sumtry	--;	if(!result){delay(1);}							//	Уменьшаем количество попыток записи и устанавливаем задержку при неудаче.
										}	while		(!result && sumtry>0);							//	Повторяем запись если она завершилась неудачей, но не более sumtry попыток.
									break;																//
								//	Действие № 1 - прочитать данные из потенциометра:					//
									case 1:																//
										do{	result	 =	iMetroI2C.readBytes( i1, REG_DATA, data, 2);	//	Читаем 2 байта из модуля с адресом i1, начиная с регистра REG_DATA в массив data.
											sumtry	--;	if(!result){delay(1);}							//	Уменьшаем количество попыток чтения и устанавливаем задержку при неудаче.
										}	while		(!result && sumtry>0);							//	Повторяем чтение если оно завершилось неудачей, но не более sumtry попыток.
										res_changed	|=	bool (	data[0] &  bit(0)	);					//	Устанавливаем флаг (не сбрасывая его) если АЦП изменилось более чем на res_change значений.
										res_adc		 =			data[1];								//	Сохраняем текущее значение АЦП.
									break;																//
								}																		//
								return result;															//
		}																								//
																										//
//		Получаем значение переменных:																	//
		void	setVar			(int i0=NOT2, int i1=NOT2	){											//
								switch(i0){																//
									case 0: res_change = i1; break;										//	Получаем значение АЦП, при изменении на которое установится флаг CHANGED: 1 ... 255.
								}																		//
		}																								//
																										//
//		Возвращаем значение переменных:																	//
		long	getVar			(int i0=NOT2){															//
								bool f=0;																//	Объявляем временную переменную для вывода флагов, значение которых должно обнуляться после вывода.
								switch(i0){																//
									case 0:								  return long(res_adc);	break;	//	Возвращаем значение АЦП, это значение пропорционально углу поворота ручки потенциометра:	0 ... 255.
									case 1:	f=res_changed; res_changed=0; return long(f);		break;	//  Возвращаем флаг указывающий что значение АЦП изменилось более чем на res_change.            Флаг res_changed сбрасывается после отправки своего значения.
									default:							  return 0;				break;	//
								}																		//
		}																								//
																										//
	private:																							//
	/**	Внутренние переменные **/																		//
		uint8_t	res_adc;																				//	Объявляем переменную для хранения показаний АЦП, это значение пропорционально углу поворота ручки потенциометра:	0 ... 255.
		uint8_t	res_change;																				//	Объявляем переменную для хранения значения АЦП, при изменении на которое установится флаг CHANGED:					1 ... 255.
		bool	res_changed;																			//	Объявляем переменную для хранения флага указывающего на то, что АЦП изменилось более чем на res_change значений.
};																										//
																										//
#endif																									//

/* =======================================================================================================================================================================================================

Действия функций библиотеки:

read( [ параметр     ] )               - считывает все данные о потенциометре, а возвращаемое значение зависит от параметра функции (по умолчанию RES_ADC):
        RES_ADC                        - вернуть значение АЦП (ADC) снятое с потенциометра (от 0 до 255), это значение пропорционально углу поворота ручки потенциометра.
        RES_CHANGED                    - вернуть флаг CHANGED регистра REG_DATA. Если данный флаг был установлен ранее, но не был прочитан, то функция read( RES_CHANGED ) вернёт 1 вне зависимости от текущего значения флага CHANGED.
set( чувствительность )                - установка чувствительности для срабатывания флага CHANGED. Чувствительность указывается в диапазоне значений АЦП (ADC) от 1 до 255.

Таблица регистров модуля:

                   ╔══════════════╤══════════════╤══════════════╤══════════════╤══════════════╤══════════════╤══════════════╤══════════════╤═════════════════════════════════════════════════════════════╗
                   ║       7      │       6      │       5      │       4      │       3      │       2      │       1      │       0      │                                                             ║
                   ╠══════════════╪══════════════╪══════════════╪══════════════╪══════════════╪══════════════╪══════════════╪══════════════╪═════════════════════════════════════════════════════════════╣
0x00 REG_FLAGS_0   ║  FLG_RESET   │FLG_SELF_TEST │       -      │       -      │       -      │       -      │GET_PIN_ADDRES│GET_PIN_OUTPUT│ Служебные флаги для чтения.                                 ║
0x01 REG_BITS_0    ║  SET_RESET   │SET_SELF_TEST │       -      │       -      │       -      │       -      │       -      │SET_PIN_OUTPUT│ Служебные флаги для записи.                                 ║
0x02 REG_FLAGS_1   ║       -      │       -      │       -      │       -      │       -      │       -      │       -      │       -      │ Служебные флаги для чтения.                                 ║
0x03 REG_BITS_1    ║       -      │       -      │       -      │       -      │       -      │       -      │       -      │       -      │ Служебные флаги для записи.                                 ║
                   ╟──────────────┴──────────────┴──────────────┴──────────────┴──────────────┴──────────────┴──────────────┴──────────────┼─────────────────────────────────────────────────────────────╢
0x04 REG_MODEL   █ ║                                                             MODEL  [7-0] = 0x03 - потенциометр                        │ Тип датчика                                                 ║
0x05 REG_VERSION   ║                                                             VERSION[7-0] = 0x00                                       │ Версия прошивки                                             ║
0x06 REG_ADDRESS   ║                                                             ADDRESS[6-0] = 0x09                        │ IF_PIN_ADDRES│ Текущий адрес на шине                                       ║
0x07 REG_CHIP_ID   ║                                                             CHIP_ID[7-0] = 0xC3                                       │ ID линейки чипов                                            ║
                   ╟───────────────────────────────────────────────────────────────────────────────────────────────────────────────────────┼─────────────────────────────────────────────────────────────╢
0x08 REG_WRITE     ║                                                             WRITE_0[7-0]                                              │ Зарезервирован                                              ║
0x09 REG_WRITE+1   ║                                                             WRITE_1[7-0]                                              │ Зарезервирован                                              ║
0x0A REG_WRITE+2   ║                                                             WRITE_2[7-0]                                              │ Зарезервирован                                              ║
0x0B REG_WRITE+3   ║                                                             WRITE_3[7-0]                                              │ Зарезервирован                                              ║
0x0C REG_WRITE+4   ║                                                             WRITE_4[7-0]                                              │ Зарезервирован                                              ║
0x0D REG_WRITE+5   ║                                                             WRITE_5[7-0]                                              │ Зарезервирован                                              ║
0x0E REG_WRITE+6   ║                                                             WRITE_6[7-0]                                              │ Зарезервирован                                              ║
0x0F REG_WRITE+7   ║                                                             WRITE_7[7-0]                                              │ Зарезервирован                                              ║
                   ╟──────────────┬──────────────┬──────────────┬──────────────┬──────────────┬──────────────┬──────────────┬──────────────┼─────────────────────────────────────────────────────────────╢
0x10 REG_DATA    █ ║       -      │       -      │       -      │       -      │       -      │       -      │       -      │   CHANGED    │ Статусные флаги                                             ║
                 █ ╟──────────────┴──────────────┴──────────────┴──────────────┴──────────────┴──────────────┴──────────────┴──────────────┼─────────────────────────────────────────────────────────────╢
0x11 REG_DATA+1  █ ║                                                             ADC[7-0]                                                  │ Значение АЦП снятое с потенциометра                         ║
0x12 REG_DATA+2  █ ║                                                             ADC_CHANGE[7-0] = 0x0A = 10 из 255                        │ Если ADC изм. более чем на ADC_CHANGE то установится CHANGED║
                   ╚═══════════════════════════════════════════════════════════════════════════════════════════════════════════════════════╧═════════════════════════════════════════════════════════════╝

CHANGED          - флаг указывает на то, что показания АЦП «ADC» изменились на более чем «ADC_CHANGE» значений с момента последней установки флага «CHANGED». Флаг сбрасывается аппаратно после чтения регистра REG_DATA.
ADC				 - Значение АЦП снятое с потенциометра (от 0 до 255), это значение пропорционально углу поворота ручки потенциометра.
ADC_CHANGE       - Значение, при изменении АЦП «ADC» на которое, установится флаг CHANGED.

*/