// ПРИМЕР ДЛЯ ОДНОГО ДАТЧИКА ВЛАЖНОСТИ И ТЕМПЕРАТУРЫ:                                  // В данном примере мы не просто выводим температуру и влажность, а задаём диапазоны для вывода данных, это экономит место при выводе данных в монитор.
                                                                                       //
// (2RM) Реле электромеханическое на 2 канала (Metro-модуль):                          //
// (8X8) LED Матрица 8x8 - I2C (Metro-модуль):                                         // https://iarduino.ru/shop/Expansion-payments/led-matrica-8x8---i2c-metro-modul.html
// (BUZ) Зуммер - I2C (Metro-модуль):                                                  // https://iarduino.ru/shop/Expansion-payments/zummer---i2c-metro-modul.html
// (DHT) Датчик температуры и влажности - I2C (Metro-модуль):                          // https://iarduino.ru/shop/Sensory-Datchiki/metro_temperature_humidity.html
// (DSL) Датчик освещенности, люксметр - I2C (Metro-модуль):                           // https://iarduino.ru/shop/Sensory-Datchiki/metro_luxmeter.html
// (EXT) Расширитель выводов - I2C (Metro-модуль):                                     // https://iarduino.ru/shop/Expansion-payments/metro-expander.html
// (KEY) Кнопка - I2C (Metro-модуль):                                                  // https://iarduino.ru/shop/Expansion-payments/knopka---i2c-metro-modul.html
// (RES) Потенциометр - I2C (Metro-модуль):                                            //
// (RGB) RGB светодиод - I2C (Metro-модуль):                                           // https://iarduino.ru/shop/Expansion-payments/rgb-svetodiod---i2c-metro-modul.html
// Плата управления Metro Leonardo:                                                    // https://iarduino.ru/shop/boards/metro-leonardo.html
// Плата управления Metro ESP:                                                         // https://iarduino.ru/shop/boards/metro-esp.html
// Информация о подключении модулей к шине I2C:                                        // https://wiki.iarduino.ru/page/i2c_connection/
                                                                                       //
#include <Wire.h>                                                                      // Подключаем библиотеку для работы с аппаратной шиной I2C, до подключения библиотеки iarduino_Metro.
#include <iarduino_Metro.h>                                                            // Подключаем библиотеку.
                                                                                       //
uint8_t sum;                                                                           // Объявляем переменную для хранения количества найденных модулей Metro.
                                                                                       //
void setup(){                                                                          //
//  Определяем все модули на шине I2C и сохраняем их количество в переменную sum:      //
    sum=iarduino_Metro_Start(&Wire); // &Wire1, &Wire2 ...                             // Функция принимает два необязательных параметра: ссылка на объект шины I2C (по умолчанию &Wire), номер адресного вывода (по умолчанию 12).
//  Теперь нам доступен массив Metro содержащий sum элементов для управления модулями. // Metro[0] управляет ближайшим к Arduino модулем, Metro[1] управляет следующим модулем и т.д до последнего модуля Metro[sum-1].
                                                                                       //
//  Готовимся выводить информацию в монитор последовательного порта:                   //
    Serial.begin(9600);                                                                // Инициируем связь с монитором последовательного порта на скорости 9600 бит/сек.
    while(!Serial){;}                                                                  // Ждём готовность к работе аппаратной шины UART.
                                                                                       //
//  Проверяем наличие модулей Metro на шине I2C:                                       //
    while(sum==0){;}                                                                   // Если модули Metro не обнаружены, то входим в бесконечный цикл while, тогда цикл loop выполняться не будет.
    while(Metro[0].model!=MOD_DHT){;}                                                  // Если ближайший к Arduino модуль Metro не является датчиком влажности и температуры, то так же входим в бесконечный цикл while.
                                                                                       //
    delay(6000);                                                                       // Ждём 6 секунд для стабилизации показаний датчика.
                                                                                       //
//  Задаём диапазон изменений показаний датчика, на который требуется реагировать:     //
    Metro[0].set(2,10);                                                                // Функция set задаёт диапазон изменений в показаниях датчика (от текущего значения) для срабатывания функции read с параметрами DHT_CHANGED_TEM и DHT_CHANGED_HUM.
                                                                                       // Первый параметр функции set задаёт изменение температуры на которое следует реагировать (от 1 до 25°С), а второй изменение влажности (от 1 до 25%).
//  Выводим начальные показания температуры и влажности:                               //
    Serial.print  ("Температура ");                                                    // Выводим текст.
    Serial.print  ( Metro[0].read( DHT_TEMPERATURE ) );                                // Выводим температуру.
    Serial.println("°C");                                                              // Выводим текст с переводом строки.
    Serial.print  ("Влажность ");                                                      // Выводим текст.
    Serial.print  ( Metro[0].read( DHT_HUMIDITY    ) );                                // Выводим влажность.
    Serial.println("%");                                                               // Выводим текст с переводом строки.
}                                                                                      //
                                                                                       //
void loop(){                                                                           //
//  Если температура изменилась на заданное ранее значение:                            //
    if( Metro[0].read(DHT_CHANGED_TEM) ){                                              // Функция read с параметром DHT_CHANGED_TEM вернёт true только если температура изменилась на 2°С и более (это значение мы указали в качестве первого аргумента функции set).
//      То выводим текущую температуру:                                                // Теперь функция read с параметром DHT_CHANGED_TEM вернёт true только если температура опять изменится на 2°С и более.
        Serial.print  ("Температура ");                                                // Выводим текст.
        Serial.print  ( Metro[0].read( DHT_TEMPERATURE ) );                            // Выводим температуру.
        Serial.println("°C");                                                          // Выводим текст с переводом строки.
    }                                                                                  //
//  Если влажность изменилась на заданное ранее значение:                              //
    if( Metro[0].read(DHT_CHANGED_HUM) ){                                              // Функция read с параметром DHT_CHANGED_HUM вернёт true только если влажность изменилась на 10% и более (это значение мы указали в качестве второго аргумента функции set).
//      То выводим текущую влажность:                                                  // Теперь функция read с параметром DHT_CHANGED_HUM вернёт true только если влажность опять изменится на 10% и более.
        Serial.print  ("Влажность ");                                                  // Выводим текст.
        Serial.print  ( Metro[0].read( DHT_HUMIDITY    ) );                            // Выводим влажность.
        Serial.println("%");                                                           // Выводим текст с переводом строки.
    }                                                                                  //
    delay(3000);                                                                       // Ставим задержку на 3 секунды. Проверять показания чаще нет смысла, так как показания чипа модуля (по умолчанию) обновляются 1 раз в 3 секунды.
}                                                                                      //